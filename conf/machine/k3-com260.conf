## conf/machine/k3-com260.conf
```bitbake
#@TYPE: Machine
#@NAME: K3 CoM260
#@SOC: Spacemit K3
#@DESCRIPTION: Machine configuration platforms based on the SpacemiT K3 CoM260

require conf/machine/include/k3-vendor.inc

KERNEL_DEVICETREE ?= "spacemit/k3_com260.dtb"

IMAGE_BOOT_FILES += " \
        k3_com260.dtb \
	"

MACHINE_EXTRA_RRECOMMENDS += "\
        linux-firmware-rtl8851 \
        linux-firmware-rtl8852 \
        linux-firmware-rtl8922 \
        "
```

## conf/machine/k3-pico-itx.conf
```bitbake
#@TYPE: Machine
#@NAME: K3 Pico-ITX
#@SOC: Spacemit K3
#@DESCRIPTION: Machine configuration for K3 Pico-ITX development board

require conf/machine/include/k3-vendor.inc

KERNEL_DEVICETREE ?= "spacemit/k3-pico-itx.dtb"

IMAGE_BOOT_FILES += " \
        k3-pico-itx.dtb \
	"
```

## conf/machine/muse-pi-pro.conf
```bitbake
#@TYPE: Machine
#@NAME: muse-pi-pro
#@SOC: Ky X1
#@DESCRIPTION: Machine configuration for MusePi Pro

require include/k1.inc

PREFERRED_PROVIDER_virtual/kernel ?= "linux-muse-pi-pro"
PREFERRED_PROVIDER_virtual/bootloader ?= "u-boot-muse-pi-pro"

KERNEL_DEVICETREE ?= "spacemit/k1-x_MUSE-Pi-Pro.dtb"

UBOOT_MACHINE = "k1_defconfig"

# let u-boot-spl-k1 handle the binary
SPL_BINARY = ""
UBOOT_ENV = "boot"
UBOOT_ENV_SUFFIX = "scr"

RISCV_SBI_PLAT = "generic"

KERNEL_CLASSES = "kernel"
KERNEL_IMAGETYPE = "Image"

EXTRA_IMAGEDEPENDS += "u-boot-muse-pi-pro u-boot-spl-k1"

IMAGE_BOOT_FILES += " \
	${UBOOT_ENV}.${UBOOT_ENV_SUFFIX} \
	k1-x_MUSE-Pi-Pro.dtb \
	${KERNEL_IMAGETYPE} \
	initramfs.img \
	env_k1-x.txt"

INITRAMFS_FSTYPES = "cpio.gz"
IMAGE_FSTYPES += " wic.gz wic.bmap ext4"
IMAGE_CLASSES:append = " muse-pi-pro-image"

WIC_CREATE_EXTRA_ARGS ?= "--no-fstab-update"
WKS_FILE ?= "muse-pi-pro.wks"

SERIAL_CONSOLES = "115200;ttyS0"
MACHINE_FEATURES = "screen keyboard ext2 ext3 serial"
MACHINE_EXTRA_RRECOMMENDS += "kernel-modules"
```

## wic/muse-pi-pro.wks
```
# Muse Pi Pro SD Card Layout
bootloader --ptable gpt

part private   --offset 64K    --fixed-size 64K   --fstype=none --part-name="private"
part fsbl      --offset 128K   --fixed-size 256K  --fstype=none --source rawcopy --sourceparams="file=FSBL.bin" --part-name="fsbl"
part env       --offset 384K   --fixed-size 64K   --fstype=none --part-name="env"
part opensbi   --offset 448K   --fixed-size 320K  --fstype=none --source rawcopy --sourceparams="file=fw_dynamic.bin" --part-name="opensbi"
part uboot     --offset 768K   --fixed-size 2048K --fstype=none --source rawcopy --sourceparams="file=u-boot-fdt.itb" --part-name="uboot"

part /boot --ondisk mmcblk0 --fstype=ext4 --label bootfs --source bootimg-partition --use-uuid --align 4096
part /     --ondisk mmcblk0 --fstype=ext4 --label rootfs --source rootfs --use-uuid --align 4096
```
